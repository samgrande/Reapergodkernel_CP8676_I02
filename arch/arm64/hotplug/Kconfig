## arch/arm64/hotplug/Kconfig
```kconfig
config THUNDERPLUG_CONTROL
	bool "Enable plugging down/up of cores based on load per core"
	help
	  This driver hotplugs cpu cores based on per-core load

config USES_MALI_MP2_GPU
	bool "Enable hotplugging feature for Mali GPUs"
	default n
	help
	  This option enables hotplugging features inside thunderplug 
	  for Mali GPUs.

config INTELLI_PLUG
         bool "Enable intelli-plug cpu hotplug driver"
         default n
         help
           Generic Intelli-plug cpu hotplug driver for ARM SOCs
 
config BRICKED_HOTPLUG
 	bool "Enable kernel based mpdecision"
 	depends on MSM_RUN_QUEUE_STATS
 	default y
 	help
 	  This enables kernel based multi core control.
 
config FAST_HOTPLUG
 	bool "Enable fast hotplug"
 	default n
 	help
 	  Kernel based core control.
 
config CLUSTER_PLUG
         bool "Enable cluster-plug cpu hotplug driver"
         default n
         help
           CPU hotplug driver designed for ARM big.LITTLE systems where
           both the big and little CPUs are of the same type. On these
           systems, it preferable to normall use the big cluster, and
           only activate the little cluster for highly parallel loads.
           This hotplug implementation always keeps the big cluster
           online, and only activates the little cluster for heavy
           parallel loads.
```

## drivers/input/fpc_linux/Kconfig
```kconfig
config FINGERPRINT_FPC_FULL_FUNCTION
     default n
     tristate "FPC 1020 family fingerprint sensor support"	
     depends on SPI_MASTER
```

## drivers/input/fpc_tee/Kconfig
```kconfig
config FINGERPRINT_FPC_TEE_FUNCTION
     default y
     tristate "FPC 1020 family fingerprint sensor support"	
     depends on SPI_MASTER
```
